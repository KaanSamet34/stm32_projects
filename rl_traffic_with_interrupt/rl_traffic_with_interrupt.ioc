# file: rl_traffic_with_interrupt.ioc
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Mcu.Family=STM32F1
Mcu.Name=STM32F103C(8-B)Tx
Mcu.Package=LQFP48
NVIC.EXTI15_10_IRQn=true\:0\:0\:false\:false\:true\:true\:true\:true
NVIC.PriorityGroup=NVIC_PRIORITYGROUP_4
PA13.Mode=Serial_Wire
PA13.Signal=SYS_JTMS-SWDIO
PA14.Mode=Serial_Wire
PA14.Signal=SYS_JTCK-SWCLK
PB11.GPIO_ModeDefaultEXTI=GPIO_MODE_IT_FALLING
PB11.Signal=GPXTI11
ProjectManager.HeapSize=0x200
ProjectManager.StackSize=0x400
ProjectManager.TargetToolchain=CMake
RCC.APB1Freq_Value=8000000
RCC.APB2Freq_Value=8000000
board=custom

// file: Core/Src/main.c
/* USER CODE BEGIN Header */
/**
  ******************************************************************************
  * @file           : main.c
  * @brief          : Main program body
  ******************************************************************************
  * @attention
  *
  * Copyright (c) 2026 STMicroelectronics.
  * All rights reserved.
  *
  * This software is licensed under terms that can be found in the LICENSE file
  * in the root directory of this software component.
  * If no LICENSE file comes with this software, it is provided AS-IS.
  *
  ******************************************************************************
  */
/* USER CODE END Header */
#include "main.h"

/* USER CODE BEGIN Includes */
#include <stdbool.h>
#include <stdint.h>
/* USER CODE END Includes */

/* USER CODE BEGIN PD */
#define PERIPHERAL_ADDR 0x40000000

#define EXTI_ADDR PERIPHERAL_ADDR + 0x10400

#define EXTI_IMR_OFFSET   0x00
#define EXTI_EMR_OFFSET   0x04
#define EXTI_RTSR_OFFSET  0x08
#define EXTI_FTSR_OFFSET  0x0C
#define EXTI_SWIER_OFFSET 0x10
#define EXTI_PR_OFFSET    0x14

#define GPIO_ADDR PERIPHERAL_ADDR + 0x10800

#define GPIO_PORTA_ADDR GPIO_ADDR + (0x400 * 0)
#define GPIO_PORTB_ADDR GPIO_ADDR + (0x400 * 1)
#define GPIO_PORTC_ADDR GPIO_ADDR + (0x400 * 2)

#define GPIO_CRL_OFFSET  0x00
#define GPIO_CRH_OFFSET  0x04

#define GPIO_IDR_OFFSET  0x08
#define GPIO_ODR_OFFSET  0x0C

#define GPIO_BSRR_OFFSET 0x10
#define GPIO_BRR_OFFSET  0x14

#define GPIO_LCKR_OFFSET 0x18

#define AFIO_ADDR 0x40010000
#define AFIO_EXTICR3_OFFSET 0x10

#define CORTEXM3_ADDR 0xE0000000

#define NVIC_ADDR CORTEXM3_ADDR + 0xE100

#define NVIC_ISER0_OFFSET 0x00

typedef enum  {
  gpioa = GPIO_PORTA_ADDR,
  gpiob = GPIO_PORTB_ADDR,
  gpioc = GPIO_PORTC_ADDR
} GPIOPort;

typedef enum {
  write,
  read
} GPIOPinDirection;

#define BUTTON_PIN  11
#define BUTTON_PORT gpiob

#define GREEN_LED_PIN  12
#define GREEN_LED_PORT gpiob

#define YELLOW_LED_PIN  13
#define YELLOW_LED_PORT gpiob

#define RED_LED_PIN  14
#define RED_LED_PORT gpiob

typedef enum {
  idle,
  pressed,
  hold_down,
  released
} button_state;

typedef struct {
  uint32_t pin;
  GPIOPort port;
} led_t;

typedef struct {
  led_t* current_led;
  led_t* previous_led;
} traffic_state_t;

typedef struct{
  uint32_t pin;
  GPIOPort port;
  button_state state;
} button_t;

/* USER CODE END PD */

/* USER CODE BEGIN PV */
led_t green_led = {.pin = GREEN_LED_PIN, .port = GREEN_LED_PORT};
led_t yellow_led = {.pin = YELLOW_LED_PIN, .port = YELLOW_LED_PORT};
led_t red_led = {.pin = RED_LED_PIN, .port = RED_LED_PORT};
traffic_state_t traffic_state = {&yellow_led, &yellow_led};
button_t button = {BUTTON_PIN, BUTTON_PORT, idle};
/* USER CODE END PV */

void SystemClock_Config(void);
/* USER CODE BEGIN PFP */
void gpio_pin_toggle( GPIOPort port, uint32_t pin);
uint32_t gpio_read_odr( GPIOPort port);
void delay(uint32_t);
void gpio_port_initialize(GPIOPort port);
void gpio_pin_configure(GPIOPort port, uint32_t pin, GPIOPinDirection direction);
void update_traffic_light(traffic_state_t* traffic_state, button_t* button);
bool gpio_pin_value(GPIOPort port, uint32_t pin);
void button_state_update(button_t* button);
uint32_t gpio_read_idr(GPIOPort port);
void configure_interrupt(void);
void nvic_configure(void);
/* USER CODE END PFP */

int main(void)
{

  /* MCU Configuration--------------------------------------------------------*/

  /* Reset of all peripherals, Initializes the Flash interface and the Systick. */
  HAL_Init();

  /* Configure the system clock */
  SystemClock_Config();

  /* Infinite loop */
  /* USER CODE BEGIN WHILE */

  gpio_port_initialize(gpiob);

  gpio_pin_configure(red_led.port, red_led.pin, write);
  gpio_pin_configure(yellow_led.port, yellow_led.pin, write);
  gpio_pin_configure(green_led.port, green_led.pin, write);
  gpio_pin_configure(button.port, button.pin, read);

  gpio_pin_toggle(yellow_led.port, yellow_led.pin);

  configure_interrupt();

  while (1)
  {
    update_traffic_light(&traffic_state, &button);
    delay(1000);

    /* USER CODE END WHILE */

  }
}

void SystemClock_Config(void)
{
  RCC_OscInitTypeDef RCC_OscInitStruct = {0};
  RCC_ClkInitTypeDef RCC_ClkInitStruct = {0};

  /** Initializes the RCC Oscillators according to the specified parameters
  * in the RCC_OscInitTypeDef structure.
  */
  RCC_OscInitStruct.OscillatorType = RCC_OSCILLATORTYPE_HSI;
  RCC_OscInitStruct.HSIState = RCC_HSI_ON;
  RCC_OscInitStruct.HSICalibrationValue = RCC_HSICALIBRATION_DEFAULT;
  RCC_OscInitStruct.PLL.PLLState = RCC_PLL_NONE;
  if (HAL_RCC_OscConfig(&RCC_OscInitStruct) != HAL_OK)
  {
    Error_Handler();
  }

  /** Initializes the CPU, AHB and APB buses clocks
  */
  RCC_ClkInitStruct.ClockType = RCC_CLOCKTYPE_HCLK|RCC_CLOCKTYPE_SYSCLK
                              |RCC_CLOCKTYPE_PCLK1|RCC_CLOCKTYPE_PCLK2;
  RCC_ClkInitStruct.SYSCLKSource = RCC_SYSCLKSOURCE_HSI;
  RCC_ClkInitStruct.AHBCLKDivider = RCC_SYSCLK_DIV1;
  RCC_ClkInitStruct.APB1CLKDivider = RCC_HCLK_DIV1;
  RCC_ClkInitStruct.APB2CLKDivider = RCC_HCLK_DIV1;

  if (HAL_RCC_ClockConfig(&RCC_ClkInitStruct, FLASH_LATENCY_0) != HAL_OK)
  {
    Error_Handler();
  }
}

/* USER CODE BEGIN 4 */

void configure_interrupt(void){
  // Set Button Pin's Interrupt Mask to 1
  uint32_t* reg_imr = (uint32_t*) (EXTI_ADDR + EXTI_IMR_OFFSET);
  *reg_imr |= (1U << BUTTON_PIN);

  // Set the relevant FTSR Bit (Falling Edge) to 1
  uint32_t* reg_ftsr = (uint32_t*) (EXTI_ADDR + EXTI_FTSR_OFFSET);
  *reg_ftsr |= (1U << BUTTON_PIN);

  // Set the relevant RTSR (Rising Edge) Bit to 0
  uint32_t* reg_rtsr = (uint32_t*) (EXTI_ADDR + EXTI_RTSR_OFFSET);
  *reg_rtsr &= ~(1U << BUTTON_PIN);

  uint32_t* reg_afio = (uint32_t*) (AFIO_ADDR + AFIO_EXTICR3_OFFSET);
  *reg_afio |= (0x1 << (BUTTON_PIN % 4) * 4);

}

void nvic_configure(void){
  HAL_NVIC_SetPriority(EXTI15_10_IRQn, 1, 0);
  HAL_NVIC_EnableIRQ(EXTI15_10_IRQn);
}

void HAL_GPIO_EXTI_Callback(uint16_t GPIO_Pin){

    if(traffic_state.current_led != &red_led) {traffic_state.previous_led = traffic_state.current_led;}

    // Toggle Off Current LED
    gpio_pin_toggle(traffic_state.current_led->port, traffic_state.current_led->pin);

    // Toggle On Red LED
    gpio_pin_toggle(red_led.port, red_led.pin);

    traffic_state.current_led = &red_led;
}

void update_traffic_light(traffic_state_t* traffic_state, button_t* button){

  button_state_update(button);

  if(traffic_state->current_led == &red_led){
    delay(500);
    // Extinguish the current led

    if(button->state == hold_down || button->state == pressed){return;}

    gpio_pin_toggle(traffic_state->current_led->port, traffic_state->current_led->pin);
    gpio_pin_toggle(traffic_state->previous_led->port, traffic_state->previous_led->pin);
    traffic_state->current_led = traffic_state->previous_led;

  }

  // Extinguish the current led
  gpio_pin_toggle(traffic_state->current_led->port, traffic_state->current_led->pin);

  // Update the previous led
  traffic_state->previous_led = traffic_state->current_led;

  // Light the next led and update state
  if(traffic_state->current_led == &yellow_led){
    gpio_pin_toggle(green_led.port, green_led.pin);
    traffic_state->current_led = &green_led;
  }
  else if(traffic_state->current_led == &green_led){
    gpio_pin_toggle(yellow_led.port, yellow_led.pin);
    traffic_state->current_led = &yellow_led;
  }

  return;
}

void gpio_port_initialize(GPIOPort port){
  switch (port) {
    case gpioa:
      __HAL_RCC_GPIOA_CLK_ENABLE();
      break;
    case gpiob:
      __HAL_RCC_GPIOB_CLK_ENABLE();
      break;
    case gpioc:
      __HAL_RCC_GPIOC_CLK_ENABLE();
      break;
  }

  __HAL_RCC_AFIO_CLK_ENABLE();
  nvic_configure();
}

void button_state_update(button_t* button){
  // 0 is the value received when the button is pressed
  if(!gpio_pin_value(button->port, button->pin)){
    // Debounce
    delay(20);

    if(!gpio_pin_value(button->port, button->pin)){
      // Button is actually down
      // Only proceed if button was not already pressed
      switch (button->state) {
        case idle:
          button->state = pressed;
          break;
        case pressed:
          button->state = hold_down;
          break;
        case hold_down:
          break;
        case released:
          button->state = pressed;
        }

        return;
      }
    }

  switch (button->state){
      case idle:
        button->state = idle;
        break;
      case pressed:
        button->state = released;
        break;
      case hold_down:
        button->state = released;
        break;
      case released:
          button->state = idle;
    }
}

bool gpio_pin_value(GPIOPort port, uint32_t pin){
  uint32_t value = gpio_read_idr(port);
  uint32_t mask = (1 << pin);
  uint32_t reading = value & mask;

  if(reading == 0) return false;
  return true;
}

void gpio_pin_configure(GPIOPort port, uint32_t pin, GPIOPinDirection direction){
  uint32_t* config_reg_addr;

  // Write to CRH
  if(pin > 7 && pin < 16){
    config_reg_addr = (uint32_t*) (port + GPIO_CRH_OFFSET);
  }
  // Write to CRL
  else if(pin <= 7){
    config_reg_addr = (uint32_t*) (port + GPIO_CRL_OFFSET);
  }

  // Copy the current value
  uint32_t config_value = *config_reg_addr;

  // 00 01: CNF 0 and 1 = 0 while MODE == 01
  if(direction == write){
    config_value &= ~(0xF << pin % 8 * 4);
    config_value |= (0x1 << pin % 8 * 4);
  }

  // 01 00: CNF 0 and 1 = 01 while MODE == 00
  else {
    config_value &= ~(0xF << pin % 8 * 4);
    config_value |= (0x4 << pin  % 8 * 4);
  }

  *config_reg_addr =  config_value;
}

void gpio_pin_toggle(GPIOPort port, uint32_t pin){
  uint32_t* odr_reg_addr = (uint32_t*) (port + GPIO_ODR_OFFSET);

  // Read the pin value first
  uint32_t value = gpio_read_odr(port);

  // Set Mask
  uint32_t mask = (1 << pin);

  // XOR operation to flip the bit
  value ^= mask;

  *odr_reg_addr = value;
}

uint32_t gpio_read_odr(GPIOPort port){
  uint32_t* odr_reg_addr = (uint32_t*) (port + GPIO_ODR_OFFSET);
  return *odr_reg_addr;
}

uint32_t gpio_read_idr(GPIOPort port){
  uint32_t* idr_reg_addr = (uint32_t*) (port + GPIO_IDR_OFFSET);
  return *idr_reg_addr;
}

void delay(uint32_t time){
  HAL_Delay(time);
}
/* USER CODE END 4 */

void Error_Handler(void)
{
  __disable_irq();
  while (1)
  {
  }
}
